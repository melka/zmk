## app/boards/xtensa/esp32keys/Kconfig.board
```kconfig
# ESP32KEYS board configuration

# Copyright (c) 2017 Intel Corporation
# SPDX-License-Identifier: Apache-2.0

config BOARD_ESP32KEYS
	bool "ESP32KEYS"
	depends on SOC_ESP32
```

## app/boards/xtensa/esp32keys/Kconfig.defconfig
```kconfig
# ESP32 board configuration

# Copyright (c) 2017 Intel Corporation
# SPDX-License-Identifier: Apache-2.0

if BOARD_ESP32KEYS

config BOARD
	default "esp32keys"
	depends on BOARD_ESP32

config ZMK_KEYBOARD_NAME
    default "ESP32Keys"

config ZMK_KSCAN_MATRIX_POLLING
    default y

config BT
	default y

config ZMK_BLE
	default y

config HEAP_MEM_POOL_SIZE
	default 16384

config ENTROPY_GENERATOR
	default y

choice BT_HCI_BUS_TYPE
	default BT_ESP32
endchoice

endif # BOARD_ESP32KEYS
```

## app/boards/xtensa/esp32keys/esp32keys_defconfig
```kconfig
# SPDX-License-Identifier: Apache-2.0

CONFIG_XTENSA_RESET_VECTOR=n

CONFIG_BOARD_ESP32KEYS=y
CONFIG_SOC_ESP32=y

CONFIG_MAIN_STACK_SIZE=2048

CONFIG_SYS_CLOCK_HW_CYCLES_PER_SEC=240000000

CONFIG_CONSOLE=n
CONFIG_SERIAL=n
CONFIG_UART_CONSOLE=n
CONFIG_LOG=n

CONFIG_XTENSA_USE_CORE_CRT1=y

CONFIG_GPIO=y

CONFIG_GEN_ISR_TABLES=y
CONFIG_GEN_IRQ_VECTOR_TABLE=n

CONFIG_CLOCK_CONTROL=y

CONFIG_NVS=y
CONFIG_SETTINGS=y
CONFIG_SETTINGS_NVS=y
CONFIG_FLASH=y
CONFIG_FLASH_PAGE_LAYOUT=y
CONFIG_FLASH_MAP=y

CONFIG_ZMK_BLE_CLEAR_BONDS_ON_START=y

CONFIG_BT_CTLR_TX_PWR_PLUS_8=y
```

## app/boards/xtensa/samsung60/Kconfig.board
```kconfig
# Copyright (c) 2021 The ZMK Contributors
# SPDX-License-Identifier: MIT

config BOARD_ESP32
	bool "SAMSUNG60"
	depends on SOC_ESP32
```

## app/boards/xtensa/ttgo_t1/Kconfig.board
```kconfig
# Copyright (c) 2021 The ZMK Contributors
# SPDX-License-Identifier: MIT

config BOARD_ESP32
	bool "TTGO-T1"
	depends on SOC_ESP32
```

## app/boards/xtensa/ttgo_t1/Kconfig.defconfig
```kconfig
# Copyright (c) 2021 The ZMK Contributors
# SPDX-License-Identifier: MIT

config BOARD
	default "esp32"
	depends on BOARD_ESP32

config ZMK_KEYBOARD_NAME
	default "TTGO-T1"

config ENTROPY_ESP32_RNG
	default y if ENTROPY_GENERATOR

if BT

config HEAP_MEM_POOL_SIZE
	default 16384

config ENTROPY_GENERATOR
	default y

choice BT_HCI_BUS_TYPE
	default BT_ESP32
endchoice

endif # BT

config ZMK_SLEEP
	default n

config ZMK_BLE
	default y

config ZMK_USB
	default n

config ZMK_BATTERY_VOLTAGE_DIVIDER
	default n

config ZMK_RGB_UNDERGLOW
	default n

config ZMK_EXT_POWER
	default n

config ZMK_USB_LOGGING
	default n
```
